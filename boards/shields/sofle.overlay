/ {
    chosen {
        zephyr,display = &oled;
    };
};

&oled {
    compatible = "solomon,ssd1306fb";  /* use "sinowealth,sh1106fb" se for SH1106 */
    width = <128>;
    height = <32>;
    segment-offset = <0>;
    page-offset = <0>;
    display-offset = <0>;
    flip = <0>;
};
