&i2c0 {
    status = "okay";
    /* Se 0x44 não funcionar, tente o endereço 0x74 usado em algumas revisões */
    tps43: iqs5xx@44 {
        compatible = "azoteq,iqs5xx";
        reg = <0x44>;
        /* Pino 107 = Porto 1, Pino 7 */
        irq-gpios = <&gpio1 7 (GPIO_ACTIVE_LOW | GPIO_PULL_UP)>;
        resolution = <800>;
    };
};

&oled {
    status = "disabled";
};
