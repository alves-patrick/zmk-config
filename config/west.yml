## config/west.yml
```yaml
manifest:
  defaults:
    revision: v0.3
  remotes:
    - name: zmkfirmware
      url-base: https://github.com/zmkfirmware
    - name: azoteq-driver
      url-base: https://github.com/AYM1607
    - name: mctechnology17
      url-base: https://github.com/mctechnology17
  projects:
    - name: zmk
      remote: zmkfirmware
      import: app/west.yml
    - name: zmk-driver-azoteq-iqs5xx
      remote: azoteq-driver
      revision: main
      path: drivers/input/azoteq
    - name: zmk-nice-oled
      remote: mctechnology17
      revision: main
      path: zmk-nice-oled
  self:
    path: config
```
