&i2c0 {
    status = "okay";
    oled: ssd1306@3c {
        compatible = "solomon,ssd1306fb";
        reg = <0x3c>;
        width = <128>;
        height = <32>;
        /* ... mantenha suas configs de offset/rotation aqui ... */
    };
};
